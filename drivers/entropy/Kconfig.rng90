## drivers/entropy/Kconfig.rng90
```kconfig
# Copyright (c) 2026 Jacob Schloss
# SPDX-License-Identifier: Apache-2.0

config ENTROPY_RNG90
	bool "Microchip RNG90 driver"
	default y
	depends on CRC
#	depends on DT_HAS_MICROCHIP_RNG90_TRNG_ENABLED
	select ENTROPY_HAS_DRIVER
	help
	  This option enables the driver for the Microchip RNG90 RNG.
```

## dts/bindings/rng/microchip,rng90-trng.yaml
```yaml
# Copyright (c) 2026 Jacob Schloss
# SPDX-License-Identifier: Apache-2.0

description: Microchip RNG90 TRNG

compatible: "microchip,rng90-trng"

include: i2c-device.yaml
```
